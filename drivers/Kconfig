## dts/bindings/i2c/nxp,sc16is7xx.yaml
```yaml
description: Opito SC16IS7xx I2C DUAL UART

compatible: "nxp,sc16is7xx"

include: [i2c-device.yaml]

properties:
    reg:
      required: true

    spr:
      type: int
      required: false
      description: |
        Value of the SPR register

    interrupt-gpios:
      type: phandle-array
      required: false
      description: Interrupt GPIO pin (active-low open-drain)

    num-ports:
      type: int
      required: true
      description: |
        Number of serial ports on this device. 

child-binding:
    include: [uart-controller.yaml]

    description: UART device over SC16IS7XX IC

    properties:
        "#address-cells":
            required: true
            const: 1
        "#size-cells":
            required: true
            const: 0

        reg:
          required: true

        spr:
          type: int
          required: false
          description: |
            Value of the SPR register

        serial-mode:
          required: false
          type: string
          description: |
            Configures the GPIO for the electrical interface selected
            Default to RS232 if not specified. This is only available on 
            the Optio interface as we have wired on SP330E transceiver 
            to the SC16IS752 GPIOs
          enum:
            - "rs232"
            - "rs485"
            - "rs422"
```

## dts/bindings/serial/nxp,sc16is7xx-serial.yaml
```yaml
description: Opito SC16IS7xx I2C DUAL UART

compatible: "nxp,sc16is7xx-serial"

include: [uart-controller.yaml]

child-binding:
    description: UART device over SC16IS7XX IC
    
    properties:
        reg:
          required: true

        spr:
          type: int
          required: false
          description: |
            Value of the SPR register

        serial-mode:
          required: false
          type: string
          description: |
            Configures the GPIO for the electrical interface selected
            Default to RS232 if not specified. This is only available on 
            the Optio interface as we have wired on SP330E transceiver 
            to the SC16IS752 GPIOs
          enum:
            - "rs232"
            - "rs485"
            - "rs422"
```
